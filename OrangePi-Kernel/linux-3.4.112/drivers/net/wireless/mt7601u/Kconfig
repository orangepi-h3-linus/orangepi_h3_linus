## OrangePi-Kernel/linux-3.4.112/drivers/net/wireless/mt7601u/Kconfig
```kconfig
config WLAN_VENDOR_MEDIATEK
	bool "MediaTek devices"
	default y
	---help---
	  If you have a wireless card belonging to this class, say Y.

	  Note that the answer to this question doesn't directly affect the
	  kernel: saying N will just cause the configurator to skip all
	  the questions about  cards. If you say Y, you will be asked for
	  your specific card in the following questions.

if WLAN_VENDOR_MEDIATEK
	config MT7601U
		tristate "MediaTek MT7601U (USB) support"
		depends on MAC80211
		depends on USB
		---help---
	  	This adds support for MT7601U-based wireless USB dongles.
endif # WLAN_VENDOR_MEDIATEK
```

## OrangePi-Kernel/linux-4.9/drivers/gpu/drm/sunxi/Kconfig
```kconfig
#
# Allwinner Video configuration
#

config DRM_SUNXI
	tristate "DRM Support for Allwinner Video"
	depends on DRM && OF
	depends on ARCH_SUNXI || COMPILE_TEST
	select DRM_KMS_HELPER
	select DRM_KMS_CMA_HELPER
	select DRM_GEM_CMA_HELPER
	help
	  Choose this option if you have a Allwinner chipset.

config DRM_SUNXI_DE2
	tristate "Support for Allwinner Video with DE2 interface"
	depends on DRM_SUNXI
	help
	  Choose this option if your Allwinner chipset has the DE2 interface
	  as the A64, A83T and H3. If M is selected the module will be called
	  sunxi-de2-drm.

config DRM_SUNXI_DE2_HDMI
	tristate "Support for DE2 HDMI"
	depends on DRM_SUNXI_DE2
	select SND_SOC_SUNXI_HDMI if SND_SOC
	help
	  Choose this option if you use want HDMI on DE2.
	  If M is selected the module will be called sunxi-de2-hdmi.
```
